/*
 * Copyright (c) 2020 The ZMK Contributors
 *
 * SPDX-License-Identifier: MIT
 */

#include "dfu.h"

/ {
    behaviors {
        // Behavior can be invoked on peripherals, so name must be <= 8 characters.
        dfu: dfu {
            compatible = "zmk,behavior-reset";
            type = <0xA8>;
            #binding-cells = <0>;
            display-name = "dfu";
        };
    };
};
