
/ {
    chosen {
        zmk,kscan = &kscan0;
        zmk,matrix_transform = &default_transform;
        zephyr,display = &ssd1306_ssd1306_128x32;
    };
    
    &arduino_i2c {
    	status = "okay";
    
    	ssd1306_ssd1306_128x32: ssd1306@3c {
    		compatible = "solomon,ssd1306fb";
    		reg = <0x3c>;
    		width = <128>;
    		height = <32>;
    		segment-offset = <0>;
    		page-offset = <0>;
    		display-offset = <0>;
    		multiplex-ratio = <31>;
    		segment-remap;
    		com-invdir;
    		com-sequential;
    		prechargep = <0x22>;
    	};
    
    };
};
