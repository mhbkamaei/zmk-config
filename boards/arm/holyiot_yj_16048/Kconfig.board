## boards/arm/holyiot_yj_16048/Kconfig.board
```kconfig
# Copyright (c) 2020 The ZMK Contributors
# SPDX-License-Identifier: MIT

config BOARD_HOLYIOT_YJ_16048
	bool "holyiot yj_16048"
	depends on SOC_NRF52832_QFAA

#
# Copyright (c) 2023 Nordic Semiconductor
#
# SPDX-License-Identifier: LicenseRef-Nordic-5-Clause
#

DT_CHOSEN_EXT_FLASH:= nordic,pm-ext-flash

config NCS_SAMPLE_MCUMGR_BT_OTA_DFU
	bool "MCUmgr OTA DFU over Bluetooth"
	select MCUMGR
	select NET_BUF
	select ZCBOR
	select CRC
	select MCUMGR_TRANSPORT_BT
	imply MCUMGR_TRANSPORT_BT_CONN_PARAM_CONTROL
	imply IMG_MANAGER
	imply STREAM_FLASH
	imply FLASH_MAP
	imply FLASH
	imply MCUMGR_GRP_IMG
	imply MCUMGR_GRP_OS
	imply MCUMGR_GRP_OS_BOOTLOADER_INFO
	imply MCUMGR_TRANSPORT_BT_REASSEMBLY
	imply NORDIC_QSPI_NOR if $(dt_chosen_enabled,$(DT_CHOSEN_EXT_FLASH))
	imply NCS_SAMPLE_MCUMGR_BT_OTA_DFU_SPEEDUP
	help
	  Enable this option to include MCUmgr in the build which will enable
	  the Bluetooth transport and image management group, which allows
	  for firmware over the air update support of the device.

if NCS_SAMPLE_MCUMGR_BT_OTA_DFU

config NCS_SAMPLE_MCUMGR_BT_OTA_DFU_MCUBOOT_DIRECT_XIP_SUPPORT
	bool
	default y if MCUBOOT_BOOTLOADER_MODE_DIRECT_XIP
	default y if MCUBOOT_BOOTLOADER_MODE_DIRECT_XIP_WITH_REVERT
	imply MCUMGR_GRP_IMG_REJECT_DIRECT_XIP_MISMATCHED_SLOT

config MCUMGR_TRANSPORT_BT_AUTHEN
	default n

config IMG_ERASE_PROGRESSIVELY
	default y

if MCUMGR_TRANSPORT_BT_REASSEMBLY

config MCUMGR_TRANSPORT_NETBUF_SIZE
	default 2475

config MCUMGR_GRP_OS_MCUMGR_PARAMS
	default y

endif # MCUMGR_TRANSPORT_BT_REASSEMBLY

if (SETTINGS_FCB || SETTINGS_NVS)

# Enable support for the storage erase operation only when the storage
# partition is created by the Partition Manager.

config MCUMGR_GRP_ZBASIC
	default y

config MCUMGR_GRP_ZBASIC_STORAGE_ERASE
	default y

endif # (SETTINGS_FCB || SETTINGS_NVS)

if NORDIC_QSPI_NOR

config NORDIC_QSPI_NOR_FLASH_LAYOUT_PAGE_SIZE
	default 4096

config NORDIC_QSPI_NOR_STACK_WRITE_BUFFER_SIZE
	default 16

endif # NORDIC_QSPI_NOR

# Align supported targets with their default MCUboot configuration.

endif # NCS_SAMPLE_MCUMGR_BT_OTA_DFU
```

## boards/arm/holyiot_yj_16048/Kconfig.defconfig
```kconfig
# Copyright (c) 2020 The ZMK Contributors
# SPDX-License-Identifier: MIT

if BOARD_HOLYIOT_YJ_16048

config BOARD
    default "holyiot_yj_16048"

config ZMK_KEYBOARD_NAME
    default "virgoBLE"

config BT_CTLR
    default BT

endif # BOARD_HOLYIOT_YJ_16048
```

## boards/arm/holyiot_yj_16048/Kconfig.holyiot_yj_16048
```kconfig
# Holyiot YJ-16048 board configuration

# Copyright (c) 2019 Henrik Brix Andersen <henrik@brixandersen.dk>
# SPDX-License-Identifier: Apache-2.0

config BOARD_HOLYIOT_YJ_16048
	select SOC_NRF52832_QFAA
```

## boards/arm/holyiot_yj_16048/holyiot_yj_16048_defconfig
```kconfig
# SPDX-License-Identifier: Apache-2.0

CONFIG_BOARD_HOLYIOT_YJ_16048=y
CONFIG_SOC_SERIES_NRF52X=y
CONFIG_SOC_NRF52832_QFAA=y

#CONFIG_ROM_START_OFFSET=0X1000
#CONFIG_FLASH_LOAD_OFFSET=0X26000
CONFIG_BUILD_OUTPUT_UF2=y

# enable MPU
CONFIG_ARM_MPU=y

# 32KHz clock source
CONFIG_CLOCK_CONTROL_NRF_K32SRC_XTAL=y

# enable GPIO
CONFIG_GPIO=y
CONFIG_PINCTRL=y

# Enable writing to flash
CONFIG_FLASH=y
CONFIG_FLASH_PAGE_LAYOUT=y
CONFIG_FLASH_MAP=y
CONFIG_USE_DT_CODE_PARTITION=y
CONFIG_MPU_ALLOW_FLASH_WRITE=y
CONFIG_NVS=y
CONFIG_SETTINGS_NVS=y

## we only have ble
CONFIG_ZMK_USB=n
CONFIG_ZMK_BLE=y

# debug
CONFIG_LOG=n
CONFIG_DEBUG=n
CONFIG_ASSERT=n
CONFIG_USE_SEGGER_RTT=n
```

## boards/shields/virgoBLE/Kconfig.defconfig
```kconfig
# Copyright (c) 2020 The ZMK Contributors
# SPDX-License-Identifier: MIT

config ZMK_SPLIT
    default y

config ZMK_KEYBOARD_NAME
    default "virgoBLE"

if SHIELD_VIRGOBLE_DONGLE

config ZMK_KEYBOARD_NAME
    default "virgoBLE"

config ZMK_SPLIT_ROLE_CENTRAL
    default y

config ZMK_SPLIT_BLE_CENTRAL_PERIPHERALS
    default 2

#config ZMK_SPLIT_BLE_CENTRAL_BATTERY_LEVEL_FETCHING
#    default y

#config ZMK_SPLIT_BLE_CENTRAL_BATTERY_LEVEL_PROXY
#    default y

endif

if SHIELD_VIRGOBLE_TST || SHIELD_VIRGOBLE_LEFT  || SHIELD_VIRGOBLE_RIGHT

config ZMK_KSCAN_DEBOUNCE_PRESS_MS
    default 1

config ZMK_KSCAN_DEBOUNCE_RELEASE_MS
    default 5

endif

if SHIELD_VIRGOBLE_RIGHT

config ZMK_KEYBOARD_NAME
    default "virgoBLE-right"

endif

if SHIELD_VIRGOBLE_LEFT

config ZMK_KEYBOARD_NAME
    default "virgoBLE-left"

endif
```

## boards/shields/virgoBLE/Kconfig.shield
```kconfig
# Copyright (c) 2020 The ZMK Contributors
# SPDX-License-Identifier: MIT

config SHIELD_VIRGOBLE_DONGLE
    def_bool $(shields_list_contains,virgoBLE_dongle)

config SHIELD_VIRGOBLE_LEFT
    def_bool $(shields_list_contains,virgoBLE_left)

config SHIELD_VIRGOBLE_RIGHT
    def_bool $(shields_list_contains,virgoBLE_right)

config SHIELD_VIRGOBLE_TST
    def_bool $(shields_list_contains,virgoBLE_tst)
```

## config/west.yml
```yaml
manifest:
  remotes:
    - name: zmkfirmware
      url-base: https://github.com/zmkfirmware
    # Additional modules containing boards/shields/custom code can be listed here as well
    #- name: caksoylar # <-- new entry
    #  url-base: https://github.com/caksoylar
    #- name: mhbkamaei # <-- new entry
    #  url-base: https://github.com/mhbkamaei
    - name: mcu-tools
      url-base: https://github.com/mcu-tools
  projects:
    - name: zmk
      remote: zmkfirmware
      revision: main
      import: app/west.yml
    #- name: zmk-rgbled-widget # <-- new entry
    #  remote: caksoylar
    #  revision: main
    #- name: zmk-led-module # <-- new entry
     # remote: mhbkamaei
     # revision: main
    - name: mcuboot
      remote: mcu-tools
      revision: main
  self:
    path: config
```
