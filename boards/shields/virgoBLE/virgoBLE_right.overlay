/*
 * Copyright (c) 2020 The ZMK Contributors
 *
 * SPDX-License-Identifier: MIT
 */

#include "virgoBLE.dtsi"

    &default_transform {
        col-offset = <5>;
    };

    &kscan0 {
        col-gpios
            = <&gpio0 20 GPIO_ACTIVE_HIGH>
            , <&gpio0 19 GPIO_ACTIVE_HIGH>
            , <&gpio0 18 GPIO_ACTIVE_HIGH>
            , <&gpio0 17 GPIO_ACTIVE_HIGH>
            , <&gpio0 16 GPIO_ACTIVE_HIGH>
            , <&gpio0 15 GPIO_ACTIVE_HIGH>
            ;
};