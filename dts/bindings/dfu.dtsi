/*
 * Copyright (c) 2020 The ZMK Contributors
 *
 * SPDX-License-Identifier: MIT
 */

/ {
    behaviors {
        // Behavior can be invoked on peripherals, so name must be <= 8 characters.
        sys_reset: sysreset {
            compatible = "zmk,behavior-reset";
            #binding-cells = <0>;
            display-name = "DFU";
        };

        // Behavior can be invoked on peripherals, so name must be <= 8 characters.
        bootloader: bootload {
            compatible = "zmk,behavior-reset";
            type = 0xA8;
            #binding-cells = <0>;
            display-name = "dfu";
        };
    };
};